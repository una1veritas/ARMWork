/*
 7-17-2011
 Spark Fun Electronics 2011
 Nathan Seidle
 
 This code is public domain but you buy me a beer if you use this and we meet someday (Beerware license).
 
 This code writes a series of images and text to the Nokia 5110 84x48 graphic LCD:
 http://www.sparkfun.com/products/10168
 
 Do not drive the backlight with 5V. It will smoke. However, the backlight on the LCD seems to be 
 happy with direct drive from the 3.3V regulator.

 Although the PCD8544 controller datasheet recommends 3.3V, the graphic Nokia 5110 LCD can run at 3.3V or 5V. 
 No resistors needed on the signal lines.
 
 You will need 5 signal lines to connect to the LCD, 3.3 or 5V for power, 3.3V for LED backlight, and 1 for ground.
 */

/*
#include "armcore.h"
#include "gpio.h"
#include "delay.h"
#include "SPI.h"
*/
#include <ctype.h>

#include "PCD8544.h"
#include "fonts.h"
/*
void setup(void) {
  LCDInit(); //Init the LCD
}

void loop(void) {
  LCDClear();
  LCDBitmap(SFEFlame);
  delay(1000);

  LCDClear();
  LCDBitmap(SFEFlameBubble);
  delay(1000);

  LCDClear();
  LCDBitmap(awesome);
  delay(1000);

  LCDClear();
  LCDString("Hello World!");
  delay(1000);
}
*/
void PCD8544::gotoXY(int x, int y) {
	select();
  write(0, 0x80 | x);  // Column.
  write(0, 0x40 | y);  // Row.  ?
	deselect();
	textcursor = x + y* 84 ;
}

void PCD8544::cursor(int col) {
	textcursor = col;
}

//This takes a large array of bits and sends them to the LCD
void PCD8544::drawBitmap(const byte my_array[]){
	select();
  for (int index = 0 ; index < (LCD_X * LCD_Y / 8) ; index++)
    write(LCD_DATA, my_array[index]);
	deselect();
}

//This function takes in a character, looks it up in the font table/array
//And writes it to the screen
//Each character is 8 bits tall and 5 bits wide. We pad one blank column of
//pixels on each side of the character for readability.
void PCD8544::drawCharacter(const char ch) {
	if ( font[2] == 'F' )
		drawFixedFont(font, ch);
	else
		drawProportionalFont(font, ch);
}

void PCD8544::drawFixedFont(const byte font[], char character) {
	uint16 width = font[0];
	uint16 bytespercolumn = font[1]/8 + (font[1]%8 ? 1 : 0);

	uint16 idx = 3 + (character - ' ') * width * bytespercolumn;
	
	if ( (textcursor % 84) + width+2 >= 84 )
		textcursor = (textcursor/84 + 1)*84;
	if ( character == 0x20 && textcursor%84 == 0 )
		return;
	select();
	for(int bytepos = 0; bytepos < bytespercolumn; bytepos++) {
		write(0, 0x80 | textcursor % 84);  // Column.
		write(0, 0x40 | bytespercolumn*(textcursor/84) + bytepos ); //0+bytepos+(textcursor/84)*percolbytes);  // Row.  ?
		write(LCD_DATA, 0x00); //Blank vertical line padding
		for (int i = 0 ; i < width ; i++) {
			write(LCD_DATA, font[idx + bytepos + i*bytespercolumn]);
		}
		write(LCD_DATA, 0x00); //Blank vertical line padding
	}
	deselect();
	//
	textcursor += width + 2;

}

//This function takes in a character, looks it up in the font table/array
//And writes it to the screen
//Each character is 8 bits tall and 5 bits wide. We pad one blank column of
//pixels on each side of the character for readability.
void PCD8544::drawProportionalFont(const byte font[], char character) {
//	byte mxwidth = font[0];
	byte height = font[1];
//	byte proportional = font[2];

	byte percolbytes = height/8 + height%2;
//	byte textrow = textcursor/percolbytes;
	
	uint16 idx = 3;
	byte fontwidth;
	byte ch = 0x20;
	for( ; ch != character; ch++) 
		idx += 1 + font[idx]*percolbytes;
	fontwidth = font[idx];
	idx++;
	
	if ( (textcursor % 84) + fontwidth+2 >= 84 )
		textcursor = (textcursor/84 + 1)*84;
	if ( character == 0x20 && textcursor%84 == 0 )
		return;
	select();
	for(int bytepos = 0; bytepos < percolbytes; bytepos++) {
		write(0, 0x80 | textcursor % 84);  // Column.
		write(0, 0x40 | percolbytes*(textcursor/84) + bytepos ); //0+bytepos+(textcursor/84)*percolbytes);  // Row.  ?
		write(LCD_DATA, 0x00); //Blank vertical line padding
		for (int i = 0 ; i < fontwidth ; i++) {
			write(LCD_DATA, font[idx + bytepos + i*percolbytes]);
		}
		write(LCD_DATA, 0x00); //Blank vertical line padding
	}
	deselect();
	//
	textcursor += fontwidth + 2;
}

//Given a string of characters, one by one is passed to the LCD
void PCD8544::drawString(const char *characters) {
  while (*characters)
    drawCharacter(*characters++);
}

//Clears the LCD by writing zeros to the entire screen
void PCD8544::clear(void) {
	select();
  for (int index = 0 ; index < (LCD_X * LCD_Y / 8) ; index++)
    write(LCD_DATA, 0x00);
	deselect();
  gotoXY(0, 0); //After we clear the display, return to the home position
}

//This sends the magical commands to the PCD8544
void PCD8544::init(void) {
	
  //Configure control pins
  //pinMode(pin_SCE, OUTPUT);
  pinMode(pin_RESET, OUTPUT);
  pinMode(pin_DC, OUTPUT);
  //pinMode(pin_SDIN, OUTPUT);
  //pinMode(pin_SCLK, OUTPUT);
	digitalWrite(pin_RESET, HIGH);
	delay(5);
	
  //Reset the LCD to a known state
  digitalWrite(pin_RESET, LOW);
  digitalWrite(pin_RESET, HIGH);

	select();
  write(LCD_COMMAND, 0x21); //Tell LCD that extended commands follow
  write(LCD_COMMAND, 0xB1); //Set LCD Vop (Contrast): Try 0xB1(good @ 3.3V) or 0xBF if your display is too dark
  write(LCD_COMMAND, 0x04); //Set Temp coefficent
  write(LCD_COMMAND, 0x14); //LCD bias mode 1:48: Try 0x13 or 0x14

  write(LCD_COMMAND, 0x20); //We must send 0x20 before modifying the display control mode
  write(LCD_COMMAND, 0x0C); //Set display control, normal mode. 0x0D for inverse
	deselect();
}


void PCD8544::setContrast(const uint8 val) {
	
	select();
  write(LCD_COMMAND, 0x21); //Tell LCD that extended commands follow
  write(LCD_COMMAND, val); //Set LCD Vop (Contrast): Try 0xB1(good @ 3.3V) or 0xBF if your display is too dark
  write(LCD_COMMAND, 0x04); //Set Temp coefficent
  write(LCD_COMMAND, 0x14); //LCD bias mode 1:48: Try 0x13 or 0x14

  write(LCD_COMMAND, 0x20); //We must send 0x20 before modifying the display control mode
  write(LCD_COMMAND, 0x0C); //Set display control, normal mode. 0x0D for inverse
	deselect();
}


//There are two memory banks in the LCD, data/RAM and commands. This 
//function sets the DC pin high or low depending, and then sends
//the data byte
void PCD8544::write(byte data_or_command, byte data) {
	//spi_setMode(SPIBx, 64, SPI_CPOL_High, SPI_CPHA_2Edge, SPI_MSBFIRST); // mode 3, msb first
	
  digitalWrite(pin_DC, data_or_command); //Tell the LCD that we are writing either to data or a command
  //Send the data
  //digitalWrite(pin_SCE, LOW);
	spi_transfer(&spibus,data);
//  shiftOut(PIN_SDIN, PIN_SCLK, SPI_MSBFIRST, data);
  //digitalWrite(pin_SCE, HIGH);
}


//This is the SFE flame in bit form
const byte PCD8544::SFEFlame[] = {
  0x00, 0x00, 0x00, 0x00, 0x00, 0x00, 0x00, 0x00, 0x00, 0x00, 0x00, 0x00, 0x00, 0x00, 0x00, 0x00,
  0x00, 0x00, 0x00, 0x00, 0x00, 0x00, 0x00, 0x00, 0x00, 0x00, 0x00, 0x00, 0x00, 0x00, 0x00, 0x00,
  0x00, 0x00, 0x00, 0xE0, 0xF0, 0xF8, 0xFC, 0xFC, 0xFE, 0xFE, 0xFE, 0xFE, 0x1E, 0x0E, 0x02, 0x00,
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  0x00, 0x00, 0x00, 0x00, 0x00, 0x00, 0x00, 0x00, 
};

//Another SparkFun logo
/*
const byte Nokia5110::SFEFlameBubble [] = {
  0x00, 0x00, 0x00, 0x00, 0x00, 0x00, 0x00, 0x00, 0x00, 0x00, 0x00, 0x00, 0x00, 0x00, 0x00, 0x80,
  0xC0, 0xC0, 0xE0, 0xE0, 0xF0, 0xF8, 0xF8, 0xFC, 0xFC, 0xFC, 0xFC, 0xFE, 0xFE, 0xFE, 0xFE, 0xFE,
  0xFE, 0xFE, 0xFE, 0xFE, 0xFC, 0xFC, 0xFC, 0xFC, 0xFC, 0xF8, 0xF0, 0xE0, 0xE0, 0xC0, 0xC0, 0x80,
  0x00, 0x00, 0x00, 0x00, 0x00, 0x00, 0x00, 0x00, 0x00, 0x00, 0x00, 0x00, 0x00, 0x00, 0x00, 0x00,
  0x00, 0x00, 0x00, 0x00, 0x00, 0x00, 0x00, 0x00, 0x00, 0x00, 0x00, 0x00, 0x00, 0x00, 0x00, 0x00,
  0x00, 0x00, 0x00, 0x00, 0x00, 0x00, 0x00, 0x00, 0x00, 0x00, 0x00, 0x00, 0x00, 0x00, 0x80, 0xE0,
  0xF8, 0xFC, 0xFF, 0xFF, 0xFF, 0xFF, 0xFF, 0xFF, 0xFF, 0xFF, 0xFF, 0xFF, 0x7F, 0x3F, 0x3F, 0x3F,
  0x1F, 0x1F, 0x1F, 0x1F, 0x1F, 0x1F, 0x1F, 0x3F, 0x3F, 0x3F, 0x7F, 0xFF, 0xFF, 0xFF, 0xFF, 0xFF,
  0xFF, 0xFF, 0xFF, 0xFF, 0xFF, 0xFC, 0xF8, 0xE0, 0x80, 0x00, 0x00, 0x00, 0x00, 0x00, 0x00, 0x00,
  0x00, 0x00, 0x00, 0x00, 0x00, 0x00, 0x00, 0x00, 0x00, 0x00, 0x00, 0x00, 0x00, 0x00, 0x00, 0x00,
  0x00, 0x00, 0x00, 0x00, 0x00, 0x00, 0x00, 0x00, 0x00, 0x00, 0x00, 0x00, 0x00, 0x00, 0x00, 0x00,
  0xC0, 0xFC, 0xFF, 0xFF, 0xFF, 0xFF, 0xFF, 0xFF, 0xFF, 0x1F, 0x0F, 0x3F, 0x7F, 0x7F, 0x3F, 0x1E,
  0x0E, 0x00, 0x00, 0x00, 0x00, 0x00, 0x00, 0x00, 0x00, 0x00, 0x00, 0x00, 0x00, 0x00, 0x00, 0x00,
  0x01, 0x03, 0x0F, 0x3F, 0xFF, 0xFF, 0xFF, 0xFF, 0xFF, 0xFF, 0xFF, 0xFF, 0xFF, 0xFC, 0x00, 0x00,
  0x00, 0x00, 0x00, 0x00, 0x00, 0x00, 0x00, 0x00, 0x00, 0x00, 0x00, 0x00, 0x00, 0x00, 0x00, 0x00,
  0x00, 0x00, 0x00, 0x00, 0x00, 0x00, 0x00, 0x00, 0x00, 0x00, 0x00, 0x00, 0x00, 0x00, 0x00, 0x00,
  0x00, 0x00, 0x00, 0x00, 0x01, 0x3F, 0xFF, 0xFF, 0xFF, 0xFF, 0xFF, 0xFF, 0xFF, 0xFC, 0xF0, 0xE0,
  0xE0, 0xC0, 0xC0, 0xE0, 0xE0, 0xE0, 0xF0, 0xF8, 0x7C, 0x7C, 0x7E, 0x7C, 0x38, 0x00, 0x00, 0x00,
  0x00, 0x00, 0x00, 0x00, 0x00, 0x00, 0x00, 0x00, 0x0F, 0x1F, 0x7F, 0xFF, 0xFF, 0xFF, 0xFF, 0xFF,
  0xFF, 0xFF, 0xFF, 0xF8, 0xE0, 0xC0, 0x00, 0x00, 0x00, 0x00, 0x00, 0x00, 0x00, 0x00, 0x00, 0x00,
  0x00, 0x00, 0x00, 0x00, 0x00, 0x00, 0x00, 0x00, 0x00, 0x00, 0x00, 0x00, 0x00, 0x00, 0x00, 0x00,
  0x00, 0x00, 0x00, 0x00, 0x00, 0x00, 0x00, 0x00, 0x00, 0x00, 0x01, 0x07, 0x0F, 0x3F, 0x7F, 0xFF,
  0xFF, 0xFF, 0xFF, 0xFF, 0xFF, 0xFF, 0xFF, 0xFF, 0xFF, 0xFF, 0xFF, 0xFF, 0xFF, 0xF8, 0xF0, 0xF0,
  0xE0, 0xE0, 0xE0, 0xE0, 0xE0, 0xE0, 0xE0, 0xE0, 0xE0, 0xE0, 0xE0, 0xE0, 0xE0, 0xE0, 0xE0, 0xE0,
  0xE1, 0xE3, 0xE3, 0xE7, 0xEF, 0xFF, 0xFF, 0xFF, 0xFF, 0xFF, 0xFF, 0xFE, 0xFC, 0xF8, 0xF0, 0xE0,
  0xC0, 0x80, 0x80, 0x00, 0x00, 0x00, 0x00, 0x00, 0x00, 0x00, 0x00, 0x00, 0x00, 0x00, 0x00, 0x00,
  0x00, 0x00, 0x00, 0x00, 0x00, 0x00, 0x00, 0x00, 0x00, 0x00, 0x00, 0x00, 0x00, 0x00, 0x00, 0x00,
  0x00, 0x00, 0x00, 0x00, 0x01, 0x03, 0x07, 0x07, 0x0F, 0x1F, 0x1F, 0x1F, 0x3F, 0x3F, 0x3F, 0x3F,
  0x3F, 0x3F, 0x7F, 0x7F, 0x7F, 0x7F, 0x7F, 0x7F, 0x7F, 0x7F, 0x7F, 0x7F, 0x7F, 0x7F, 0x7F, 0x7F,
  0x7F, 0x7F, 0x7F, 0x7F, 0x7F, 0x7F, 0x7F, 0x7F, 0x7F, 0x7F, 0x7F, 0x7F, 0x7F, 0x7F, 0x7F, 0x7F,
  0x7F, 0x7F, 0x7F, 0x7F, 0x7F, 0x7F, 0x7F, 0x7F, 0x7E, 0x7C, 0x78, 0x70, 0x60, 0x40, 0x40, 0x00,
  0x00,
};
*/

